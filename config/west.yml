## config/west.yml
```yaml
manifest:
  remotes:
    - name: zmkfirmware
      url-base: https://github.com/zmkfirmware
    - name: prospector
      url-base: https://github.com/t-ogura

  projects:
    - name: zmk
      remote: zmkfirmware
      revision: main
      import: app/west.yml

    # Add this:
    - name: prospector-zmk-module
      remote: prospector
      revision: v2.2.0
      path: modules/prospector-zmk-module
```
